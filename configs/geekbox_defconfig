## configs/geekbox_defconfig
```kconfig
CONFIG_ARM=y
CONFIG_ARCH_ROCKCHIP=y
CONFIG_SYS_MALLOC_F_LEN=0x1000
CONFIG_ROCKCHIP_RK3368=y
CONFIG_TARGET_GEEKBOX=y
CONFIG_DEFAULT_DEVICE_TREE="rk3368-geekbox"
CONFIG_DEBUG_UART=y
# CONFIG_DISPLAY_CPUINFO is not set
# CONFIG_CMD_IMLS is not set
CONFIG_REGMAP=y
CONFIG_SYSCON=y
CONFIG_CLK=y
CONFIG_PINCTRL=y
CONFIG_RAM=y
CONFIG_DEBUG_UART_BASE=0xFF690000
CONFIG_DEBUG_UART_CLOCK=24000000
CONFIG_DEBUG_UART_SHIFT=2
CONFIG_DEBUG_UART_ANNOUNCE=y
CONFIG_DEBUG_UART_SKIP_INIT=y
CONFIG_SYSRESET=y
CONFIG_ERRNO_STR=y
CONFIG_USB=y
CONFIG_USB_EHCI_HCD=y
CONFIG_USB_EHCI_GENERIC=y
CONFIG_CMD_USB=y
CONFIG_CMD_BOOT_ROCKCHIP=y
#Need to detect which USB device is storage, or USB BOOT won't work
CONFIG_USB_STORAGE=y 
CONFIG_ROCKCHIP_USB_BOOT=y
CONFIG_MISC=y
#CONFIG_ROCKCHIP_EFUSE shoule not be used
CONFIG_LIB_RAND=y

#Need Rockusb
CONFIG_USB_GADGET=y
CONFIG_USB_GADGET_DWC2_OTG=y
#2020-07-04: want to see if phy can be enable/disable to transfer to legacy uboot
#but CONFIG_USB_GADGET_DWC2_OTG_PHY is Samsung enxynos specific
CONFIG_USB_GADGET_DWC2_OTG_PHY=n
CONFIG_CMD_ROCKUSB=y
CONFIG_USB_GADGET_DOWNLOAD=y
#CONFIG_SPL=y
#CONFIG_SPL_BUILD=y
#CONFIG_SPL_USB_GADGET=y

#MMC command
CONFIG_MMC_DW=y
CONFIG_MMC_DW_ROCKCHIP=y
CONFIG_RKPARM_PARTITION=y
CONFIG_CMD_MMC=y

#default use rkboot
CONFIG_BOOTDELAY=1
#No effect putting BOOTCOMMAND because it's not define in any Kconfig so it will be cleared.
CONFIG_EXTRA_ENV_SETTINGS="run bootrkp;"

#TSAI: for hdmi to detect whether it's connected, it requires PMIC rk808 vcc18_lcd regulator
#PMIC depends on I2C
CONFIG_DM_PMIC=y
CONFIG_PMIC_RK8XX=y
CONFIG_SYS_I2C_ROCKCHIP=y
CONFIG_REGULATOR_RK8XX=y

#TSAI: graphics
CONFIG_DM_VIDEO=y
#OF_LIVE needed for DRM
CONFIG_OF_LIVE=y
#with kernel dtb, it will read dtb from emmc and cannot initialze USB
CONFIG_USING_KERNEL_DTB=n
#I2C_EDID itself doesn't conflict with USB-PHY, 
CONFIG_I2C_EDID=y
#CONFIG_PHY requires related section in dts
#without PHY, there will be such error 
# Bus usb@ff500000: generic_phy_get_by_index(dev=000000007bdfbeb0, index=0, phy=000000007be03a10)                                     
# generic_phy_get_by_index: uclass_get_device_by_ofnode failed: err=-19                                                               
# failed to get usb phy @drivers/usb/host/ehci-hcd.c                                                                                  
# Port not available.                                                                                                                 
# No usb[0] device found                                                                                                              
 
CONFIG_PHY=y
#TSAI: 20200704: there are another possible usb phy: ROCKCHIP_USB2_PHY, so try that
CONFIG_PHY_ROCKCHIP_INNO_USB2=y


CONFIG_DRM_ROCKCHIP=y

#trying to enable HDMI
CONFIG_DISPLAY=y
#have video rockchip so that vop can be probed
CONFIG_VIDEO_ROCKCHIP=y
CONFIG_ROCKCHIP_VENDOR_PARTITION=y
CONFIG_DRM_ROCKCHIP_DW_HDMI=y

#copied from rk3368_defconfig
CONFIG_DRM_ROCKCHIP_INNO_VIDEO_COMBO_PHY=y
CONFIG_DRM_ROCKCHIP_DW_MIPI_DSI=y
CONFIG_DRM_ROCKCHIP_ANALOGIX_DP=y
CONFIG_DRM_ROCKCHIP_LVDS=y
CONFIG_DRM_ROCKCHIP_RGB=y
CONFIG_DRM_ROCKCHIP_RK1000=y
CONFIG_LCD=y

#save env to usb storage
CONFIG_ENV_IS_IN_BLK_DEV=y
#CONFIG_DELAY_ENVIRONMENT=y //no use, will be filter out

#2020-07-16: this will init mcu, without it mailbox would not work!
CONFIG_ARCH_EARLY_INIT_R=y
```

## drivers/pci/Kconfig
```kconfig
#TSAI: copy from MainLine
menuconfig PCI
	bool "PCI support"
	default y if PPC
	help
	  Enable support for PCI (Peripheral Interconnect Bus), a type of bus
	  used on some devices to allow the CPU to communicate with its
	  peripherals.
```
